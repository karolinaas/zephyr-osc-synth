## CMakeLists.txt
```
# SPDX-License-Identifier: Apache-2.0

cmake_minimum_required(VERSION 3.20.0)

find_package(Zephyr REQUIRED HINTS $ENV{ZEPHYR_BASE})
project(zephyr_osc_synth)

file(GLOB app_sources CONFIGURE_DEPENDS ${CMAKE_CURRENT_SOURCE_DIR}/src/*.c)
target_sources(app PRIVATE ${app_sources})
```

## Kconfig
```
# Copyright (c) 2024 NXP
# SPDX-License-Identifier: Apache-2.0

source "Kconfig.zephyr"

config I2S_INIT_BUFFERS
	int "Initial count of audio data blocks"
	default 4
	help
	  Controls the initial count of audio data blocks, which are (optionally)
	  filled by data from the DMIC peripheral and played back by the I2S
	  output peripheral.

config SAMPLE_FREQ
	int "Sample rate"
	default 16000
	help
	  Sample frequency of the system.

config USE_CODEC_CLOCK
	bool "I2S BCK is generated by a selected codec device"
	help
	  If selected, the I2S selected peripheral will be configured to consume
	  (receive) the I2S BCK and WS signals and the codec will be configured
	  to generate those. If not selected, the I2S peripheral will generate
	  them and the codec will be expected to consume them.

config EXTRA_BLOCKS
	int "Number of extra blocks"
	default 32
	help
	  Extra blocks for storing PCM sample.

config SAMPLE_WIDTH
	int "Sample bit width"
	default 16
	help
	  PCM sample bit width.

config BYTES_PER_SAMPLE
	int "Bytes per sample"
	default 2
	help
	  Number of bytes per PCM sample.
```

## prj.conf
```kconfig
CONFIG_SERIAL=y
CONFIG_UART_INTERRUPT_DRIVEN=y

CONFIG_I2S=y
CONFIG_AUDIO=y
CONFIG_AUDIO_CODEC=y

CONFIG_FPU=y
CONFIG_CBPRINTF_FP_SUPPORT=y

CONFIG_MAIN_STACK_SIZE=4096

# Logging configuration
CONFIG_LOG=y
CONFIG_LOG_MODE_DEFERRED=y
CONFIG_LOG_BACKEND_UART=y
CONFIG_LOG_DEFAULT_LEVEL=3
CONFIG_LOG_PRINTK=y
CONFIG_LOG_BUFFER_SIZE=4096

CONFIG_LOG_RUNTIME_FILTERING=y
CONFIG_SHELL=y
```

## src/main.c
```c
#include <zephyr/kernel.h>
#include <zephyr/device.h>
#include <zephyr/drivers/uart.h>
#include <zephyr/logging/log.h>

#include "synth.h"
#include "workers.h"
#include "i2s_codec.h"

LOG_MODULE_REGISTER(main, LOG_LEVEL_INF);

/* peripheral DT nodes */
#define UART_DEVICE_NODE        DT_NODELABEL(arduino_serial)
#define I2S_CODEC_TX            DT_ALIAS(i2s_codec_tx)

static const struct device *const uart_dev = DEVICE_DT_GET(UART_DEVICE_NODE);
static const struct device *const i2s_dev_codec = DEVICE_DT_GET(I2S_CODEC_TX);
static const struct device *const codec_dev = DEVICE_DT_GET(DT_NODELABEL(audio_codec));

int main(void)
{
    LOG_INF("firmware build %s %s", __DATE__, __TIME__);

    struct i2s_config config;
    struct audio_codec_cfg audio_cfg;

    if (!device_is_ready(uart_dev))
    {
        LOG_ERR("UART device not found!");
        return 0;
    }

    if (!device_is_ready(i2s_dev_codec))
    {
        LOG_ERR("%s is not ready!", i2s_dev_codec->name);
        return 0;
    }

    if (!device_is_ready(codec_dev))
    {
        LOG_ERR("%s is not ready!", codec_dev->name);
        return 0;
    }

    // has to be ran before configure configure_tx_streams
    if (!codec_config(codec_dev, &audio_cfg))
    {
        LOG_ERR("failure to config codec");
        return 0;
    }

    if (!configure_tx_streams(i2s_dev_codec, &config))
    {
        LOG_ERR("failure to config streams");
        return 0;
    }

    if (!workers_init(uart_dev))
    {
        LOG_ERR("failed to initialize workers");
        return 0;
    }

    LOG_INF("synth sample starting, %d voices, sample rate %d Hz", NUM_VOICES_MAX, SAMPLE_FREQUENCY);

    bool started = false;

    while (1)
    {
        int ret;
        static int16_t sample_buff[SAMPLES_PER_BLOCK]; // generated samples, important to not be on stack to avoid stack overflow

        for (int i = 0; i < CONFIG_I2S_INIT_BUFFERS; i++)
        {
            struct synth_evt evt;

            /* drain the synth event queue to get the latest message */
            while (k_msgq_get(&synth_evt_msgq, &evt, K_NO_WAIT) == 0)
            {
                synth_update(&evt);
            }

            /* silence timed out voices */
            prune_voices();

            generate_sine(sample_buff, FRAMES_PER_BLOCK, SAMPLE_FREQUENCY, NUMBER_OF_CHANNELS);

            ret = i2s_buf_write(i2s_dev_codec, sample_buff, BLOCK_SIZE);

            if (ret < 0)
            {
                LOG_ERR("i2s_buf_write failed: %d (%s)", ret, strerror(-ret));
                break;
            }
        }

        if (ret < 0)
        {
            LOG_ERR("Error: %d (%s)", ret, strerror(-ret));
            break;
        }

        if (!started)
        {
            i2s_trigger(i2s_dev_codec, I2S_DIR_TX, I2S_TRIGGER_START);
            started = true;
            LOG_INF("I2S streams started");
        }
    }

    if (!trigger_command(i2s_dev_codec, I2S_TRIGGER_DROP))
    {
        LOG_ERR("Send I2S trigger DROP failed");
        return 0;
    }

    LOG_INF("I2S streams stopped");

    return 0;
}
```

## src/i2s_codec.c
```c
#include "i2s_codec.h"

#include <zephyr/kernel.h>
#include <zephyr/device.h>
#include <zephyr/audio/codec.h>
#include <zephyr/logging/log.h>

LOG_MODULE_REGISTER(i2s_codec, LOG_LEVEL_INF);

K_MEM_SLAB_DEFINE_IN_SECT_STATIC(mem_slab, __nocache, BLOCK_SIZE, BLOCK_COUNT, 4);

bool configure_tx_streams(const struct device *i2s_dev, struct i2s_config *config)
{
    config->word_size = SAMPLE_BIT_WIDTH;
    config->channels = NUMBER_OF_CHANNELS;
    config->format = I2S_FMT_DATA_FORMAT_I2S;
#ifdef CONFIG_USE_CODEC_CLOCK
    config->options = I2S_OPT_BIT_CLK_TARGET | I2S_OPT_FRAME_CLK_TARGET;
#else
    config->options = I2S_OPT_BIT_CLK_CONTROLLER | I2S_OPT_FRAME_CLK_CONTROLLER;
#endif
    config->frame_clk_freq = SAMPLE_FREQUENCY;
    config->mem_slab = &mem_slab;
    config->block_size = BLOCK_SIZE;
    config->timeout = I2S_TX_TIMEOUT;

    int ret;

    ret = i2s_configure(i2s_dev, I2S_DIR_TX, config);

    if (ret < 0)
    {
        LOG_ERR("Failed to configure codec stream: %d", ret);
        return false;
    }

    return true;
}

bool trigger_command(const struct device *i2s_dev, enum i2s_trigger_cmd cmd)
{
    int ret;

    ret = i2s_trigger(i2s_dev, I2S_DIR_TX, cmd);

    if (ret < 0)
    {
        LOG_ERR("Failed to trigger command %d on TX: %d", cmd, ret);
        return false;
    }

    return true;
}

bool codec_config(const struct device *codec_dev, struct audio_codec_cfg *config)
{
    config->dai_route = AUDIO_ROUTE_PLAYBACK;
    config->dai_type = AUDIO_DAI_TYPE_I2S;
    config->dai_cfg.i2s.word_size = SAMPLE_BIT_WIDTH;
    config->dai_cfg.i2s.channels = 2;
    config->dai_cfg.i2s.format = I2S_FMT_DATA_FORMAT_I2S;
#ifdef CONFIG_USE_CODEC_CLOCK
    config->dai_cfg.i2s.options = I2S_OPT_FRAME_CLK_CONTROLLER | I2S_OPT_BIT_CLK_CONTROLLER;
#else
    config->dai_cfg.i2s.options = I2S_OPT_FRAME_CLK_TARGET | I2S_OPT_BIT_CLK_TARGET;
#endif
    config->dai_cfg.i2s.frame_clk_freq = SAMPLE_FREQUENCY;
    config->dai_cfg.i2s.mem_slab = &mem_slab;
    config->dai_cfg.i2s.block_size = BLOCK_SIZE;

    int ret;

    ret = audio_codec_configure(codec_dev, config);

    if (ret < 0)
    {
        LOG_ERR("Failed to configure codec: %d", ret);
        return false;
    }

    k_msleep(1000);

    return true;
}
```

## src/i2s_codec.h
```c
#pragma once

#include <zephyr/drivers/i2s.h>
#include <zephyr/audio/codec.h>
#include <stdbool.h>

#define SAMPLE_FREQUENCY      CONFIG_SAMPLE_FREQ
#define SAMPLE_BIT_WIDTH      CONFIG_SAMPLE_WIDTH
#define BYTES_PER_SAMPLE      CONFIG_BYTES_PER_SAMPLE
#define NUMBER_OF_CHANNELS    (2U)
#define I2S_TX_TIMEOUT        (2000U)

#define INITIAL_BLOCKS        CONFIG_I2S_INIT_BUFFERS
#define BLOCK_DURATION_MS     10
#define FRAMES_PER_BLOCK      (SAMPLE_FREQUENCY * BLOCK_DURATION_MS / 1000)
#define SAMPLES_PER_BLOCK     (FRAMES_PER_BLOCK * NUMBER_OF_CHANNELS)
#define BLOCK_SIZE            (BYTES_PER_SAMPLE * SAMPLES_PER_BLOCK)
#define BLOCK_COUNT           (INITIAL_BLOCKS + CONFIG_EXTRA_BLOCKS)

bool configure_tx_streams(const struct device *i2s_dev, struct i2s_config *config);
bool trigger_command(const struct device *i2s_dev, enum i2s_trigger_cmd cmd);
bool codec_config(const struct device *codec_dev, struct audio_codec_cfg *config);
```

## src/osc.c
```c
#include "osc.h"

#include <zephyr/sys/byteorder.h>
#include <zephyr/logging/log.h>

LOG_MODULE_REGISTER(osc, LOG_LEVEL_DBG);

// helper function
static inline uint32_t osc_move4_up(uint32_t idx)
{
    return (idx + 3) & ~0x3; // move up to next multiple of 4
}

static size_t osc_arg_offset(osc_msg *msg, uint32_t arg_idx)
{
    size_t offset = 0; // relative to osc_args(msg)
    const uint8_t *type_tag_str = osc_type_tag_str(msg);

    for (uint32_t i = 0; i < arg_idx; i++)
    {
        uint8_t type_tag = type_tag_str[i];

        if (!osc_arg_type_valid(type_tag))
        {
            LOG_WRN("Invalid argument type '%c' at index %d!", type_tag, i);
            return 0; // should be impossible since we validate this during parsing
        }

        switch (type_tag)
        {
            case 'f':
            {
                offset += 4;

                break;
            }
            case 'i':
            {
                offset += 4;

                break;
            }
            case 's':
            {
                offset += strlen((char *)osc_args(msg) + offset) + 1; // string length + null terminator
                offset = osc_move4_up(offset); // strings are padded to 4 bytes

                break;
            }
            case 'b':
            {
                if (msg->idx_args + offset + 4 > msg->msg_size)
                {
                    LOG_WRN("Blob size field overflows message buffer! Malformed message.");
                    return 0;
                }

                int32_t blob_size; // int32 defined in osc spec, but should always be positive since it's a size
                memcpy(&blob_size, osc_args(msg) + offset, 4);
                blob_size = sys_be32_to_cpu(blob_size); // convert from network big-endian to cpu endian

                offset += 4 + blob_size; // size field + blob data
                offset = osc_move4_up(offset); // blobs are padded to 4 bytes

                break;
            }
        }
    }

    return offset;
}

int osc_parse_message(osc_msg *msg, uint8_t *raw_buff, size_t raw_len)
{
    // initial bound check
    if (raw_len > OSC_MSG_MAX_SIZE)
    {
        return -1; // raw buffer too long
    }

    /* check for message size prefix */
    if (raw_len >= 4 && raw_buff[0] != '/')
    {
        int32_t prefix_size;
        memcpy(&prefix_size, raw_buff, 4);
        prefix_size = sys_be32_to_cpu(prefix_size);

        if (prefix_size < 0 || (size_t)prefix_size > raw_len - 4)
        {
            LOG_WRN("Invalid prefix size %d! Message ignored.", prefix_size);
            return -1;
        }

        raw_buff += 4; // skip prefix size field
        raw_len = (size_t)prefix_size; // now raw_len is the actual size of the OSC message without the prefix
    }

    memcpy(msg->msg_data, raw_buff, raw_len);
    msg->idx_addr_pattern = 0;

    uint32_t i = 0;

    if (raw_buff[0] != '/')
    {
        LOG_WRN("Address pattern does not start with '/'! Malformed message. Message ignored.");
        return -1;
    }

    // iterate through address pattern until null char
    while (i < raw_len && raw_buff[i] != '\0')
    {
        i++;
    }

    if (i >= raw_len)
    {
        LOG_WRN("Address pattern not null-terminated! Message ignored.");
        return -1;
    }

    i = osc_move4_up(i + 1); // move up to next multiple of 4 after null char

    if (i >= raw_len)
    {
        LOG_WRN("Address pattern padding overflows the raw buffer! Should be impossible, malformed message. Message ignored.");
        return -1;
    }

    if (raw_buff[i] != ',')
    {
        LOG_WRN("Type tag string does not start with ','! Missing or malformed message. Message ignored.");
        return -1;
    }

    msg->idx_type_tag = i + 1; // type tag string starts after ','

    // iterate through type tag string until null char
    while (i < raw_len && raw_buff[i] != '\0')
    {
        i++;
    }

    if (i >= raw_len)
    {
        LOG_WRN("Type tag string not null-terminated! Missing or malformed message. Message ignored.");
        return -1; // type tag string not null terminated
    }

    // validate floats
    for (uint32_t j = msg->idx_type_tag; j < i; j++)
    {
        if (!osc_arg_type_valid(raw_buff[j]))
        {
            LOG_WRN("Unsupported argument type '%c'! Message ignored.", raw_buff[j]);
            return -1;
        }
    }

    i = osc_move4_up(i + 1); // move up to next multiple of 4 after null char

    if (i > raw_len)
    {
        LOG_WRN("Type tag string padding overflows the raw buffer! Should be impossible, malformed message. Message ignored.");
        return -1;
    }

    msg->idx_args = i; // arguments start after type tag string padding

    for (uint32_t j = 0; j < osc_num_args(msg); j++)
    {
        uint8_t type_tag = osc_type_tag_str(msg)[j];

        switch (type_tag)
        {
            case 'f':
            {
                i += 4;

                break;
            }
            case 'i':
            {
                i += 4;

                break;
            }
            case 's':
            {
                i += strnlen((char *)osc_args(msg) + i, raw_len - i) + 1;// string length + null terminator
                i = osc_move4_up(i); // strings are padded to 4 bytes

                if (i > raw_len)
                {
                    LOG_WRN("String argument overflows the raw buffer! Malformed message. Message ignored.");
                    return -1;
                }

                break;
            }
            case 'b':
            {
                if (i + 4 > raw_len)
                {
                    LOG_WRN("Blob size field overflows message buffer! Malformed message.");
                    return -1;
                }

                int32_t blob_size; // int32 defined in osc spec, but should always be positive since it's a size
                memcpy(&blob_size, osc_args(msg) + i, 4);
                blob_size = sys_be32_to_cpu(blob_size); // convert from network big-endian to cpu endian

                if (blob_size < 0 || (uint32_t)blob_size > raw_len - i - 4)
                {
                    LOG_WRN("Blob size %d invalid! Malformed message. Message ignored.", blob_size);
                    return -1;
                }

                i += 4 + blob_size; // size field + blob data
                i = osc_move4_up(i); // blobs are padded to 4 bytes

                break;
            }
        }
    }
    
    if (i > raw_len)
    {
        LOG_WRN("Arguments overflow the raw buffer! Should be impossible, malformed message. Message ignored.");
        return -1;
    }

    msg->msg_size = i; // now we know the actual size of the message, from start to end of arguments

    return msg->msg_size;
}

int osc_parse_bundle(uint8_t *raw_buff, size_t raw_len, osc_bundle_handler handler, void *cb_data)
{
    static osc_msg msg; // reuse same message struct for each message in the bundle
    size_t offset = 0;
    int num_elements = 0;

    if (raw_len < sizeof(OSC_BUNDLE_PREFIX) || memcmp(raw_buff, OSC_BUNDLE_PREFIX, sizeof(OSC_BUNDLE_PREFIX)) != 0)
    {
        LOG_WRN("Bundle does not start with \"%s\"!", OSC_BUNDLE_PREFIX);
        return -1;
    }

    offset += sizeof(OSC_BUNDLE_PREFIX) + 8; // skip bundle prefix and time tag

    if (offset > raw_len)
    {
        LOG_WRN("Bundle prefix and time tag overflow the raw buffer!");
        return -1;
    }

    while (offset < raw_len)
    {
        if (offset + 4 > raw_len)
        {
            LOG_WRN("Bundle element size overflows the raw buffer! Malformed bundle.");
            return -1;
        }

        int32_t element_size; // int32 defined in osc spec, but should always be positive since it's a size
        memcpy(&element_size, raw_buff + offset, 4);
        element_size = sys_be32_to_cpu(element_size);

        if (element_size < 0 || offset + 4 + (size_t)element_size > raw_len)
        {
            LOG_WRN("Invalid bundle element size %d! Malformed bundle.", element_size);
            return -1;
        }

        offset += 4; // skip element size prefix

        int parsed_msg_size = osc_parse_message(&msg, raw_buff + offset, (size_t)element_size);

        if (parsed_msg_size < 0)
        {
            LOG_WRN("Failed to parse message in bundle!");
            return -1;
        }

        handler(&msg, cb_data); // call handler for this message

        offset += (size_t)element_size; // move to next element
        num_elements++;
    }

    return num_elements;
}

uint8_t osc_get_arg_type(osc_msg *msg, uint32_t arg_idx)
{
    if (arg_idx >= osc_num_args(msg))
    {
        LOG_WRN("Argument index %d out of bounds (num args: %d)!", arg_idx, osc_num_args(msg));
        return 0;
    }

    return osc_type_tag_str(msg)[arg_idx];
}

float osc_get_arg_float32(osc_msg *msg, uint32_t arg_idx)
{
    if (arg_idx >= osc_num_args(msg))
    {
        LOG_WRN("Argument index %d out of bounds (num args: %d)!", arg_idx, osc_num_args(msg));
        return 0.0f; // out of bounds, maybe should handle differently?
    }

    if (osc_get_arg_type(msg, arg_idx) != 'f')
    {
        LOG_WRN("Argument index %d is not of type float!", arg_idx);
        return 0.0f;
    }

    uint32_t raw;
    float value;
    size_t offset = osc_arg_offset(msg, arg_idx);

    memcpy(&raw, osc_args(msg) + offset, 4);
    raw = sys_be32_to_cpu(raw); // convert from network big-endian to cpu endian

    memcpy(&value, &raw, 4);

    return value;
}

int32_t osc_get_arg_int32(osc_msg *msg, uint32_t arg_idx)
{
    if (arg_idx >= osc_num_args(msg))
    {
        LOG_WRN("Argument index %d out of bounds (num args: %d)!", arg_idx, osc_num_args(msg));
        return 0;
    }

    if (osc_get_arg_type(msg, arg_idx) != 'i')
    {
        LOG_WRN("Argument index %d is not of type int32!", arg_idx);
        return 0;
    }

    uint32_t raw;
    int32_t value;
    size_t offset = osc_arg_offset(msg, arg_idx);

    memcpy(&raw, osc_args(msg) + offset, 4);
    value = sys_be32_to_cpu(raw); // convert from network big-endian to cpu endian

    return value;
}

const char *osc_get_arg_string(osc_msg *msg, uint32_t arg_idx)
{
    if (arg_idx >= osc_num_args(msg))
    {
        LOG_WRN("Argument index %d out of bounds (num args: %d)!", arg_idx, osc_num_args(msg));
        return 0;
    }

    if (osc_get_arg_type(msg, arg_idx) != 's')
    {
        LOG_WRN("Argument index %d is not of type string!", arg_idx);
        return 0;
    }

    size_t offset = osc_arg_offset(msg, arg_idx);

    if (msg->idx_args + offset >= msg->msg_size)
    {
        LOG_WRN("String argument offset overflows message buffer! Malformed message.");
        return 0;
    }

    return (char *)osc_args(msg) + offset;
}

const uint8_t *osc_get_arg_blob(osc_msg *msg, uint32_t arg_idx, size_t *out_blob_size)
{
    if (arg_idx >= osc_num_args(msg))
    {
        LOG_WRN("Argument index %d out of bounds (num args: %d)!", arg_idx, osc_num_args(msg));
        return 0;
    }

    if (osc_get_arg_type(msg, arg_idx) != 'b')
    {
        LOG_WRN("Argument index %d is not of type blob!", arg_idx);
        return 0;
    }

    size_t offset = osc_arg_offset(msg, arg_idx);
    int32_t blob_size;

    memcpy(&blob_size, osc_args(msg) + offset, 4);
    blob_size = sys_be32_to_cpu(blob_size);

    if (out_blob_size)
    {
        *out_blob_size = blob_size;
    }

    return osc_args(msg) + offset + 4; // data starts after the 4 byte size prefix
}

uint64_t osc_bundle_get_time_tag(uint8_t *raw_buff)
{
    uint64_t time_tag;
    memcpy(&time_tag, raw_buff + sizeof(OSC_BUNDLE_PREFIX), 8);

    return sys_be64_to_cpu(time_tag);
}
```

## src/osc.h
```c
#pragma once

#include <stdint.h>
#include <stddef.h>
#include <string.h>
#include <stdbool.h>

#define OSC_MSG_MAX_SIZE 512 // bytes

#define OSC_BUNDLE_PREFIX "#bundle"
#define OSC_TIME_TAG_IMMEDIATELY 0x0000000000000001ULL // The time tag value consisting of 63 zero bits followed by a one in the least signifigant bit is a special case meaning “immediately.”

typedef struct osc_msg
{
    uint8_t msg_data[OSC_MSG_MAX_SIZE];

    uint32_t idx_addr_pattern;
    uint32_t idx_type_tag;
    uint32_t idx_args;

    size_t msg_size;
} osc_msg;

typedef void (*osc_bundle_handler)(osc_msg *msg, void *cb_data);

int osc_parse_message(osc_msg *msg, uint8_t *raw_buff, size_t raw_len);
int osc_parse_bundle(uint8_t *raw_buff, size_t raw_len, osc_bundle_handler handler, void *cb_data);

uint8_t osc_get_arg_type(osc_msg *msg, uint32_t arg_idx);
float osc_get_arg_float32(osc_msg *msg, uint32_t arg_idx);
int32_t osc_get_arg_int32(osc_msg *msg, uint32_t arg_idx);
const char *osc_get_arg_string(osc_msg *msg, uint32_t arg_idx);
const uint8_t *osc_get_arg_blob(osc_msg *msg, uint32_t arg_idx, size_t *out_blob_size);

uint64_t osc_bundle_get_time_tag(uint8_t *raw_buff);

// accessors for pointer convenience
static inline uint8_t *osc_addr_pattern(osc_msg *msg)
{
    return &msg->msg_data[msg->idx_addr_pattern];
}

static inline uint8_t *osc_type_tag_str(osc_msg *msg)
{
    return &msg->msg_data[msg->idx_type_tag];
}

static inline uint8_t *osc_args(osc_msg *msg)
{
    return &msg->msg_data[msg->idx_args];
}

static inline uint32_t osc_num_args(osc_msg *msg)
{
    return strlen((char *)osc_type_tag_str(msg));
}

static inline bool osc_arg_type_valid(uint8_t type_tag)
{
    return type_tag == 'f' || type_tag == 'i' || type_tag == 's' || type_tag == 'b';
}
```

## src/synth.c
```c
#include "synth.h"

#include <zephyr/logging/log.h>

LOG_MODULE_REGISTER(synth, LOG_LEVEL_DBG);

static struct synth_voice synth_voices[NUM_VOICES_MAX];

void synth_update(const struct synth_evt *evt)
{
    switch (evt->type)
    {
        case EVT_TOUCH:
        {
            if (evt->touch.finger_idx >= NUM_VOICES_MAX)
            {
                LOG_WRN("Invalid finger index %u (max %d)", evt->touch.finger_idx, NUM_VOICES_MAX - 1);
                return;
            }

            struct synth_voice *voice = &synth_voices[evt->touch.finger_idx];

            // if voice is not active, activate it and initialize phase to 0
            if (!voice->active)
            {
                voice->active = true;
                voice->phase = 0.0f;
                voice->current_frequency = evt->touch.frequency; // start at the target frequency
                voice->current_amplitude = 0.0f; // ramp up from 0 to avoid clicks

				LOG_DBG("voice %d activated f=%.1f a=%.1f", evt->touch.finger_idx, (double)evt->touch.frequency, (double)evt->touch.amplitude);
            }

            voice->released = false;
            voice->target_frequency = evt->touch.frequency;
            voice->target_amplitude = evt->touch.amplitude;
            voice->last_update_time_ms = k_uptime_get();

            break;
        }

        case EVT_TOUCH_RELEASE:
        {
            if (evt->touch.finger_idx >= NUM_VOICES_MAX)
            {
                LOG_WRN("Invalid finger index %u (max %d)", evt->touch.finger_idx, NUM_VOICES_MAX - 1);
                return;
            }

            struct synth_voice *voice = &synth_voices[evt->touch.finger_idx];

            voice->released = true;
            voice->target_amplitude = 0.0f; // ramp down to 0 to avoid clicks

			LOG_DBG("voice %d released", evt->touch.finger_idx);

            break;
        }

        default:
        {
            LOG_WRN("Unsupported event type! Event ignored.");
            break;
        }
    }
}

void generate_sine(int16_t *buff, size_t num_frames, uint32_t sample_frequency, uint8_t num_channels)
{
    for (size_t i = 0; i < num_frames; i++)
    {
        float sample_val_sum = 0;

        /* sum/mix every active voice */
        for (int j = 0; j < NUM_VOICES_MAX; j++)
        {
            struct synth_voice *voice = &synth_voices[j];

            if (voice->active)
            {
                /* smoothing transitions towards target freq and amp */
                voice->current_frequency += FREQ_SMOOTHING_FACTOR * (voice->target_frequency - voice->current_frequency);
                voice->current_amplitude += AMP_SMOOTHING_FACTOR * (voice->target_amplitude - voice->current_amplitude);

                sample_val_sum += voice->current_amplitude * sinf(voice->phase);
                voice->phase += SYNTH_TWOPI * voice->current_frequency / sample_frequency;

                /* wrap phase in range 0 to 2*pi */
                if (voice->phase >= SYNTH_TWOPI)
                {
                    voice->phase -= SYNTH_TWOPI;
                }
            }
        }

        /* clamp to max amplitude, causes clipping */
        if (sample_val_sum > INT16_MAX)
        {
            sample_val_sum = INT16_MAX;
        }
        else if (sample_val_sum < INT16_MIN)
        {
            sample_val_sum = INT16_MIN;
        }

        buff[i * num_channels] = (int16_t)sample_val_sum; // left channel
        buff[i * num_channels + 1] = (int16_t)sample_val_sum; // right channel
    }
}

void prune_voices(void)
{
    int64_t max_last_update_time_ms = 0;
    bool any_active = false;

    for (int i = 0; i < NUM_VOICES_MAX; i++)
    {
        struct synth_voice *voice = &synth_voices[i];

        if (voice->active && !voice->released)
        {
            if (!any_active || voice->last_update_time_ms > max_last_update_time_ms)
            {
                max_last_update_time_ms = voice->last_update_time_ms;
            }

            any_active = true;
        }
    }

    for (int i = 0; i < NUM_VOICES_MAX; i++)
    {
        struct synth_voice *voice = &synth_voices[i];

        if (!voice->active)
        {
            continue;
        }

        /* if a voice lags behind the most recently updated active voice by more than the timeout, it is probably hanging due to a missed release event */
        if (!voice->released && any_active && (max_last_update_time_ms - voice->last_update_time_ms > VOICE_GROUP_TIMEOUT_MS))
        {
            voice->target_amplitude = 0.0f; // to avoid clicks set target amp to zero
            voice->released = true;

			LOG_WRN("Voice %d pruned due to time-out", i);
        }

        /* if a voice has been released and its amplitude is below the prune threshold, it is safe to deactivate it */
        if (voice->released && voice->current_amplitude < VOICE_PRUNE_AMP_THRESHOLD)
        {
            voice->target_amplitude = 0.0f; // to avoid clicks set target amp to zero
            voice->active = false;
            voice->released = false;
			LOG_DBG("Voice %d deactivated", i);
        }
    }
}
```

## src/synth.h
```c
#pragma once

#include <zephyr/kernel.h>
#include <math.h>
#include <stdint.h>
#include <stdbool.h>

#define NUM_VOICES_MAX               3
#define VOICE_PRUNE_AMP_THRESHOLD    1.0f // below this amp voice is pruned
#define VOICE_GROUP_TIMEOUT_MS       50 // if a voice lags this much behind the rest of voices, it is pruned, helps prevent hanging voices when events are missed

#define FREQUENCY_MAX_HZ             1000.0f
#define AMPLITUDE_MAX                ((float)INT16_MAX / NUM_VOICES_MAX)

#define FREQ_SMOOTHING_FACTOR        0.01f // between 0 and 1, higher smoothing converges faster, shouldn't be much higher than 0,02
#define AMP_SMOOTHING_FACTOR         0.01f

#ifndef SYNTH_PI
#define SYNTH_PI 3.14159265358979323846f // float because cortex M33 can only do float, has no double hw support
#endif
#ifndef SYNTH_TWOPI
#define SYNTH_TWOPI (SYNTH_PI * 2.0f)
#endif

enum synth_evt_t
{
    EVT_TOUCH,
    EVT_TOUCH_RELEASE,
};

struct synth_evt_touch
{
    uint32_t finger_idx; // probably overkill since humans only have 10 fingers
    float frequency;
    float amplitude;
};

struct synth_evt
{
    enum synth_evt_t type;

    union
    {
        struct synth_evt_touch touch;
    };
};

struct synth_voice
{
    bool active;
    bool released;

    int64_t last_update_time_ms;

    /* target and current values necessary for smooth transitions*/
    float target_frequency; // target is set by control
    float current_frequency; // current is what is actually synthesized, glides towards target
    float target_amplitude;
    float current_amplitude;

    float phase;
};

void synth_update(const struct synth_evt *evt);
void generate_sine(int16_t *buff, size_t num_frames, uint32_t sample_frequency, uint8_t num_channels);
void prune_voices(void);
```

## src/workers.c
```c
#include "workers.h"

#include <zephyr/kernel.h>
#include <zephyr/drivers/uart.h>
#include <zephyr/logging/log.h>

#include <string.h>

#include "osc.h"
#include "synth.h"

LOG_MODULE_REGISTER(workers, LOG_LEVEL_DBG);

/* queues to store up to 10 messages (aligned to 4-byte boundary) */
K_MSGQ_DEFINE(uart_msgq, MSG_SIZE, 10, 4);
K_MSGQ_DEFINE(osc_msgq, sizeof(osc_msg), 10, 4);
K_MSGQ_DEFINE(synth_evt_msgq, sizeof(struct synth_evt), 64, 4);

/* thread to parse OSC messages from raw UART data */
K_THREAD_DEFINE(parser_thread_id, 2048, parser_thread, NULL, NULL, NULL, 5, 0, 0); // may need to adjust priority and stack size
K_THREAD_DEFINE(osc_handler_thread_id, 2048, osc_handler_thread, NULL, NULL, NULL, 6, 0, 0);
K_THREAD_DEFINE(diagnostic_thread_id, 1024, diagnostic_thread, NULL, NULL, NULL, 7, 0, 0);

/* counters for dropped messages for diagnostics */
static volatile uint32_t uart_msgq_dropped;
static volatile uint32_t osc_msgq_dropped;
static volatile uint32_t synth_msgq_dropped;

/* receive buffer used in UART ISR callback */
static char rx_buf[MSG_SIZE];
static int rx_buf_pos;

/*
 * Read individual bytes from UART until packet delimiter 0xDEADBEEF is detected.
 * Afterwards push the data to the message queue.
 */
static void uart_cb(const struct device *uart_dev, void *user_data)
{
    static uint32_t shift_reg = 0;
    uint8_t byte;

    if (!uart_irq_update(uart_dev))
    {
        return;
    }

    if (!uart_irq_rx_ready(uart_dev))
    {
        return;
    }

    /* read until FIFO empty */
    while (uart_fifo_read(uart_dev, &byte, 1) == 1)
    {
        /* shift existing bytes towards LSB by one byte, then write new byte */
        shift_reg = (shift_reg >> 8) | ((uint32_t)byte << 24);

        if (shift_reg == 0xDEADBEEF)
        {
            LOG_DBG("Shift register matched: 0x%08X", shift_reg);

            /* if queue is full, message is dropped, increment the dropped counter */
            if (k_msgq_put(&uart_msgq, &rx_buf, K_NO_WAIT) != 0)
            {
                uart_msgq_dropped++;
                LOG_WRN("UART message queue full. Message dropped.");
            }

            /* reset the buffer position and shift register */
			memset(rx_buf, 0, sizeof(rx_buf));
            rx_buf_pos = 0;
            shift_reg = 0;
        }
        else if (rx_buf_pos < sizeof(rx_buf))
        {
            rx_buf[rx_buf_pos++] = byte;
        }
        /* else: characters beyond buffer size are dropped */
    }
}

bool workers_init(const struct device *uart_dev)
{
    /* configure interrupt and callback to receive data */
    int ret = uart_irq_callback_user_data_set(uart_dev, uart_cb, NULL);

    if (ret < 0)
    {
        if (ret == -ENOTSUP)
        {
            LOG_ERR("Interrupt-driven UART API support not enabled");
        }
        else if (ret == -ENOSYS)
        {
            LOG_ERR("UART device does not support interrupt-driven API");
        }
        else
        {
            LOG_ERR("Error setting UART callback: %d", ret);
        }

        return false;
    }

    uart_irq_rx_enable(uart_dev);
    return true;
}

/*
 * Parse raw OSC message from UART and push it to the message queue.
 */
void parser_thread(void *, void *, void *)
{
    char raw_buf[MSG_SIZE];
    static osc_msg msg;

    /* indefinitely wait until uart_msgq has data, should use no cpu while waiting */
    while (k_msgq_get(&uart_msgq, &raw_buf, K_FOREVER) == 0)
    {
		int parsed_len = osc_parse_message(&msg, (uint8_t *)raw_buf, MSG_SIZE);

        if (parsed_len < 0)
        {
            LOG_WRN("OSC message parse error. Message ignored.");
			LOG_HEXDUMP_WRN((uint8_t *)raw_buf, MSG_SIZE, "Raw message data (hex dump):");
            continue;
        }

		LOG_DBG("Parsed OSC message: address pattern: %s, type tag: %s", osc_addr_pattern(&msg), osc_type_tag_str(&msg));

        /* if queue is full, message is dropped, increment the dropped counter */
        if (k_msgq_put(&osc_msgq, &msg, K_NO_WAIT) != 0)
        {
            osc_msgq_dropped++;
            LOG_WRN("OSC message queue full. Message dropped.");
        }
    }
}

void osc_handler_thread(void *, void *, void *)
{
    static osc_msg msg;

    /* indefinitely wait for input from UART peripheral */
    while (k_msgq_get(&osc_msgq, &msg, K_FOREVER) == 0)
    {
        LOG_DBG("address pattern: %s", osc_addr_pattern(&msg));
        LOG_DBG("\ttype tag: %s", osc_type_tag_str(&msg));

        int num_args = osc_num_args(&msg);

        for (int i = 0; i < num_args; i++)
        {
            LOG_DBG("\t\targument: %f", (double)osc_get_arg_float32(&msg, i));
        }

        if (!strcmp((char *)osc_addr_pattern(&msg), "/touch"))
        {
            if (num_args != 3)
            {
                LOG_WRN("Invalid number of args for /touch, expected 3, instead got %d", num_args);
                continue;
            }

            float width = osc_get_arg_float32(&msg, 1);
            float height = osc_get_arg_float32(&msg, 2);

            struct synth_evt evt;
            evt.touch.finger_idx = (uint32_t)osc_get_arg_float32(&msg, 0);

            if (height < 0.0f || width < 0.0f)
            {   
                /* S2O sends negative values for touch release */
                evt.type = EVT_TOUCH_RELEASE;
            }
            else
            {
                /* value clamp just in case */
                width = width > 1.0f ? 1.0f : width;
                height = height > 1.0f ? 1.0f : height;

                evt.type = EVT_TOUCH;
                
                evt.touch.amplitude = width * AMPLITUDE_MAX;
                evt.touch.frequency = height * FREQUENCY_MAX_HZ;
            }

            k_timeout_t timeout = evt.type == EVT_TOUCH_RELEASE ? K_MSEC(200) : K_NO_WAIT;

            /*  drop when full */
            if (k_msgq_put(&synth_evt_msgq, &evt, timeout) != 0)
            {
                synth_msgq_dropped++;
                LOG_WRN("Synth event queue full. Event dropped.");
            }

            if (evt.type == EVT_TOUCH_RELEASE)
            {
                LOG_DBG("EVT_TOUCH_RELEASE finger_idx=%u", evt.touch.finger_idx);
            }
            else
            {
                LOG_DBG("EVT_TOUCH         finger_idx=%u", evt.touch.finger_idx);
            }
        }
		else
		{
			LOG_WRN("Unhandled OSC address: %s", osc_addr_pattern(&msg));
		}
    }
}

void diagnostic_thread(void *, void *, void *)
{
    while (1)
    {
        LOG_INF("Dropped queue messages: UART: %u, OSC: %u, Synth: %u", uart_msgq_dropped, osc_msgq_dropped, synth_msgq_dropped);
        LOG_INF("Used queue slots: UART: %u, OSC: %u, Synth: %u", k_msgq_num_used_get(&uart_msgq), k_msgq_num_used_get(&osc_msgq), k_msgq_num_used_get(&synth_evt_msgq));
        k_sleep(K_SECONDS(5));
    }
}
```

## src/workers.h
```c
#pragma once

#include <zephyr/device.h>
#include <stdbool.h>

#define MSG_SIZE 512

extern struct k_msgq synth_evt_msgq;

bool workers_init(const struct device *uart_dev);
void parser_thread(void *, void *, void *);
void osc_handler_thread(void *, void *, void *);
void diagnostic_thread(void *, void *, void *);
```
